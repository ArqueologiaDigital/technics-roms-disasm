/* naka_debug_naming_link.ld — Linker script for naka_debug_naming.c
 * Auto-generated by scripts/naka_struct_decode.py
  * v7 addresses where v7's own bytes agree:
 * scripts/generators/generate_v7_naka_link_scripts.py
 */

ENTRY(0)

SECTIONS {
    .text : { *(.text*) *(.rodata*) }
    /DISCARD/ : { *(.comment) *(.note*) *(.eh_frame*) }
}

CheckTitleFunc = 0x00F97B0A;
DefMainFunction = 0x00FA4568;
DirmdTitleFunc = 0x00F9A8F4;
FDC_CMD_READ_ID = 0x0000000A;
NakaStr_DataFile1of2 = 0x00E000C3;
NakaStr_DataFilePck = 0x00E00113;
NakaData_RomEnd = 0x00FFFFFF;
MainAutoFree = 0x00F9847F;
MainBitControl = 0x00F986D0;
MainGetPmemName = 0x00F98B82;
MainGetRhythmName = 0x00F98AE0;
MainGetSoundName = 0x00F987AC;
MainPmanControl = 0x00F98C75;
MainRamControl = 0x00F98489;
MainTaskControl = 0x00F982E7;
MainTitleControl = 0x00F98DF3;
MainTrSwControl = 0x00F98C46;
NakaData_StyleBitmaps = 0x00EB70C2;
NakaInst_Param_EndFF = 0x00EE003F;
NakaInst_Param_Val00_01 = 0x00EE0017;
NakaInst_iduMurai = 0x00EB70CC;
NakaDbg_PanelSimBitmap = 0x00EB29E8;
Naka_PresentationRootState = 0x00EF0015;
SeqByteBlock_PathNormalize = 0x00F500D7;
WidgetCharMap_DataEntry1 = 0x00EAFFA4;
WidgetName_PtrBlock_G = 0x00EAFF70;
WidgetName_PtrBlock_I1 = 0x00EAFF90;
NakaInst_iduRoot = 0x00EB70D6;
NakaWidget_PanelSimulator = 0x00EB29C6;
SendPartDataBlock_Data2 = 0x00FEF728;

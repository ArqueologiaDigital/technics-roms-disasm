/* naka_sound_menu_drawbar_link.ld — Linker script for naka_sound_menu_drawbar.c
 * Auto-generated by scripts/naka_struct_decode.py
  * v7 addresses where v7's own bytes agree:
 * scripts/generators/generate_v7_naka_link_scripts.py
 */

ENTRY(0)

SECTIONS {
    .text : { *(.text*) *(.rodata*) }
    /DISCARD/ : { *(.comment) *(.note*) *(.eh_frame*) }
}

AcAccordionTabProc = 0x00F7E29A;
AcDrawEditBoxProc = 0x00F829F4;
AcDrawSettingProc = 0x00F82565;
AcDrawbarNameProc = 0x00F8260D;
AcFdemoScreenProc = 0x00F83C50;
AcLswPartEditBoxProc = 0x00F7B733;
AcLswPartPanProc = 0x00F7C3D2;
AcPartMixerProc = 0x00F80240;
AcPleaseWaitProc = 0x00F7DA0C;
AcPresentationBoxProc = 0x00F83DBB;
AcPresentationControlProc = 0x00F84012;
AcResetPageProc = 0x00F80372;
AcSndEMenuProc = 0x00F7B229;
AcTrackMixerProc = 0x00F80286;
AcVolPartEditBoxProc = 0x00F7BC62;
AcWelcomScreenProc = 0x00F7EFE6;
IvAccordionProc = 0x00F7DE14;
IvAccordionXProc = 0x00F7E218;
IvDemofeature1Proc = 0x00F83CF5;
IvDemofeature2Proc = 0x00F83D36;
IvDrawbar1Proc = 0x00F82E56;
IvDrawbar2Proc = 0x00F832EF;
IvDrawbarNormProc = 0x00F834EC;
IvDrawbarProc = 0x00F81FCB;
IvDrawbarSndEProc = 0x00F83658;
IvMPverProc = 0x00F7EFDD;
IvMesageProc = 0x00F7D8E7;
IvPageOverWriteProc = 0x00F828E5;
IvSdpartProc = 0x00F7B2E9;
IvSdscltyp2Proc = 0x00F7EA93;
IvSdtecd1Proc = 0x00F7E465;
IvSdtecdProc = 0x00F7E39F;
IvSoftverProc = 0x00F7EEEC;
Naka_PresentationRootState = 0x00EF0015;
PsLabelBoxProc = 0x00F7E6F1;
PsMixerControlProc = 0x00F7F561;
PsVariBoxProc = 0x00F83984;
VwUserBitmapSpProc = 0x00F83BD3;
ClassProps_AcDrawSetting = 0x00E80CC2;
ClassProps_AcDrawbarName = 0x00E80CDA;
ClassProps_AcFdemoScreen = 0x00E80CAA;
ClassProps_AcPleaseWait = 0x00E80CB6;
ClassProps_AcSndEMenu = 0x00E80CB0;
ClassProps_IvMPver = 0x00E80CF6;

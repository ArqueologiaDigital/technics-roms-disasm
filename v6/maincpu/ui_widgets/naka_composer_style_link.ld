/* naka_composer_style_link.ld — Linker script for naka_composer_style.c
 * Auto-generated by scripts/naka_struct_decode.py
 */

ENTRY(0)

SECTIONS {
    .text : { *(.text*) *(.rodata*) }
    /DISCARD/ : { *(.comment) *(.note*) *(.eh_frame*) }
}

CPANEL_CMD_INIT_CONFIGURE = 0x0000001F;
CRTC_LINE_COMPARE = 0x00000018;
NakaInst_BASS_ACCOMP1_ACCOMP2_ACCOMP3 = 0x00EF0001;
NakaInst_NEXT = 0x00EDFFC7;
NakaInst_Param_EndFF = 0x00EE003F;
NakaInst_Param_Repeat = 0x00EDFF9F;
NakaInst_Param_Val0C = 0x00EE0015;
Naka_Help_563_E300C0 = 0x00E300C0;
Naka_PresentationRootState = 0x00EF0015;
PlySngSel2Func = 0x00F2FE35;
Presentation_TagStrTable = 0x00E9FF0C;
SendPartDataBlock_Data4 = 0x00FF00C0;
SeqByteBlock_EffectsSeqData = 0x00F5008B;
SeqByteBlock_PathNormalize = 0x00F500D7;
WidgetCharMap_DataEntry1 = 0x00EAFFA4;
WidgetName_PtrBlock_A = 0x00EAFF0C;
WidgetName_PtrBlock_F2 = 0x00EAFF6B;
WidgetName_PtrBlock_I2 = 0x00EAFF92;

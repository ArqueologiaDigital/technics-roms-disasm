/* naka_block_007_link.ld — Linker script for naka_block_007.c
 * Auto-generated by scripts/naka_struct_decode.py
  * v7 addresses where v7's own bytes agree:
 * scripts/generators/generate_v7_naka_link_scripts.py
 */

ENTRY(0)

SECTIONS {
    .text : { *(.text*) *(.rodata*) }
    /DISCARD/ : { *(.comment) *(.note*) *(.eh_frame*) }
}

AcCtlMsgGridBoxProc = 0x00F796A0;
AcFadeSetGridBoxProc = 0x00F74DFB;
AcGMOnOffBoxProc = 0x00F742E2;
AcInOutGridBoxProc = 0x00F7532C;
AcLswFuncBoxProc = 0x00F7495E;
AcLswFuncEditBoxProc = 0x00F74BB1;
AcMidiPartGridBoxProc = 0x00F79DB8;
AcParaLoadOptGridBoxProc = 0x00F76822;
AcPcgOutGridBoxProc = 0x00F76F9E;
AcPmemOutLGridBoxProc = 0x00F77EED;
AcPmemOutRGridBoxProc = 0x00F78240;
AcVocalGridBoxProc = 0x00F73214;
NakaDesc_OnOffStyle_Table = 0x00E55790; /* v7's address: nothing in v6 places it */
NakaDesc_PageGridBox1_Table = 0x00E5597E; /* v7's address: nothing in v6 places it */
NakaDesc_PmanOnOff1_Table = 0x00E557C2; /* v7's address: nothing in v6 places it */
NakaDesc_PmanOnOff2_Table = 0x00E55806; /* v7's address: nothing in v6 places it */
ClassProps_AcFadeSetGridBox = 0x00E55850;
ClassProps_AcGMOnOffBox = 0x00E557C2;
ClassProps_AcInOutGridBox = 0x00E558A8;
ClassProps_AcMidiPartGridBox = 0x00E559BA;
ClassProps_AcParaLoadOptGridBox = 0x00E558D4;
ClassProps_AcPcgOutGridBox = 0x00E55900;
ClassProps_AcPmemOutLGridBox = 0x00E5592C;
ClassProps_AcPmemOutRGridBox = 0x00E55958;
ClassProps_AcVocalGridBox = 0x00E5587C;
ClassName_AcFadeSetGridBox = 0x00E55C3C;
ClassName_AcGMOnOffBox = 0x00E55C7C;
ClassName_AcInOutGridBox = 0x00E55C14;
ClassName_AcLswFuncBox = 0x00E55C54;
ClassName_AcLswFuncEditBox = 0x00E55C68;
ClassName_AcParaLoadOptGridBox = 0x00E55BFA;
ClassName_AcPcgOutGridBox = 0x00E55BE6;
ClassName_AcPmemOutLGridBox = 0x00E55BD0;
ClassName_AcSendEditSw = 0x00E55C90;
ClassName_AcVocalGridBox = 0x00E55C28;
ClassPropdata_AcFadeSetGridBox = 0x00E55C38;
ClassPropdata_AcGMOnOffBox = 0x00E55C7A;
ClassPropdata_AcInOutGridBox = 0x00E55C10;
ClassPropdata_AcLswFuncBox = 0x00E55C4E;
ClassPropdata_AcLswFuncEditBox = 0x00E55C62;
ClassPropdata_AcParaLoadOptGridBox = 0x00E55BF6;
ClassPropdata_AcPcgOutGridBox = 0x00E55BE2;
ClassPropdata_AcSendEditSw = 0x00E55C8A;
ClassPropdata_AcVocalGridBox = 0x00E55C24;

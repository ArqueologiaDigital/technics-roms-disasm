/* naka_perf_style_link.ld — Linker script for naka_perf_style.c
 * Auto-generated by scripts/naka_struct_decode.py
 */

ENTRY(0)

SECTIONS {
    .text : { *(.text*) *(.rodata*) }
    /DISCARD/ : { *(.comment) *(.note*) *(.eh_frame*) }
}

ExtData_ChordTypeTable_Top = 0x00ECFE7C;
NakaData_EffectsStringPtrs = 0x00E30006;
NakaInst_NEXT = 0x00EDFFC7;
NakaInst_Param_EndFF = 0x00EE003F;
NakaInst_Param_Repeat = 0x00EDFF9F;
Naka_PresentationRootState = 0x00EF0015;
SetWall_MiscDataAndCode = 0x00F1FFC6;
WidgetCharMap_DataEntry1 = 0x00EAFFA4;

/* naka_perf_style_link.ld — Linker script for naka_perf_style.c
 * Auto-generated by scripts/naka_struct_decode.py
 */

ENTRY(0)

SECTIONS {
    .text : { *(.text*) *(.rodata*) }
    /DISCARD/ : { *(.comment) *(.note*) *(.eh_frame*) }
}

ExtData_ChordTypeTable_Top = 0x00ECFEF4;
NakaData_EffectsStringPtrs = 0x00E2FFEE;
NakaInst_NEXT = 0x00EDFFAF;
NakaInst_Param_EndFF = 0x00EE0027;
NakaInst_Param_Repeat = 0x00EDFF87;
Naka_PresentationRootState = 0x00EEFFFD;
SetWall_MiscDataAndCode = 0x00F1FFAE;
WidgetCharMap_DataEntry1 = 0x00EAFF8C;

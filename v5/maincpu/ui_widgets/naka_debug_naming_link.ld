/* naka_debug_naming_link.ld — Linker script for naka_debug_naming.c
 * Auto-generated by scripts/naka_struct_decode.py
  * v7 addresses where v7's own bytes agree:
 * scripts/generators/generate_v7_naka_link_scripts.py
 */

ENTRY(0)

SECTIONS {
    .text : { *(.text*) *(.rodata*) }
    /DISCARD/ : { *(.comment) *(.note*) *(.eh_frame*) }
}

CheckTitleFunc = 0x00F977FD;
DefMainFunction = 0x00FA425B;
DirmdTitleFunc = 0x00F9A5E7;
FDC_CMD_READ_ID = 0x0000000A;
NakaStr_DataFile1of2 = 0x00E000C3;
NakaStr_DataFilePck = 0x00E00113;
NakaData_RomEnd = 0x00FFFFFF;
MainAutoFree = 0x00F98172;
MainBitControl = 0x00F983C3;
MainGetPmemName = 0x00F98875;
MainGetRhythmName = 0x00F987D3;
MainGetSoundName = 0x00F9849F;
MainPmanControl = 0x00F98968;
MainRamControl = 0x00F9817C;
MainTaskControl = 0x00F97FDA;
MainTitleControl = 0x00F98AE6;
MainTrSwControl = 0x00F98939;
NakaData_StyleBitmaps = 0x00EB70AA;
NakaInst_Param_EndFF = 0x00EE0027;
NakaInst_Param_Val00_01 = 0x00EDFFFF;
NakaInst_iduMurai = 0x00EB70B4;
NakaDbg_PanelSimBitmap = 0x00EB29D0;
Naka_PresentationRootState = 0x00EEFFFD;
SeqByteBlock_PathNormalize = 0x00F500D7; /* v6's address: nothing in v5 places it */ /* v7's address: nothing in v6 places it */
WidgetCharMap_DataEntry1 = 0x00EAFF8C;
WidgetName_PtrBlock_G = 0x00EAFF58;
WidgetName_PtrBlock_I1 = 0x00EAFF78;
NakaInst_iduRoot = 0x00EB70BE;
NakaWidget_PanelSimulator = 0x00EB29AE;

/* naka_composer_style_link.ld — Linker script for naka_composer_style.c
 * Auto-generated by scripts/naka_struct_decode.py
 */

ENTRY(0)

SECTIONS {
    .text : { *(.text*) *(.rodata*) }
    /DISCARD/ : { *(.comment) *(.note*) *(.eh_frame*) }
}

CPANEL_CMD_INIT_CONFIGURE = 0x0000001F;
CRTC_LINE_COMPARE = 0x00000018;
NakaInst_BASS_ACCOMP1_ACCOMP2_ACCOMP3 = 0x00EEFFE9;
NakaInst_NEXT = 0x00EDFFAF;
NakaInst_Param_EndFF = 0x00EE0027;
NakaInst_Param_Repeat = 0x00EDFF87;
NakaInst_Param_Val0C = 0x00EDFFFD;
Naka_Help_563_E300C0 = 0x00E300A8;
Naka_PresentationRootState = 0x00EEFFFD;
PlySngSel2Func = 0x00F2FD59;
Presentation_TagStrTable = 0x00E9FEF4;
SendPartDataBlock_Data4 = 0x00FEF394; /* v6's address: nothing in v5 places it */ /* v7's address: nothing in v6 places it */
SeqByteBlock_EffectsSeqData = 0x00F5008B; /* v6's address: nothing in v5 places it */ /* v7's address: nothing in v6 places it */
SeqByteBlock_PathNormalize = 0x00F500D7; /* v6's address: nothing in v5 places it */ /* v7's address: nothing in v6 places it */
WidgetCharMap_DataEntry1 = 0x00EAFF8C;
WidgetName_PtrBlock_A = 0x00EAFEF4;
WidgetName_PtrBlock_F2 = 0x00EAFF53;
WidgetName_PtrBlock_I2 = 0x00EAFF7A;

/* naka_direct_play_link.ld — Linker script for naka_direct_play.c
 * Auto-generated by scripts/naka_struct_decode.py
 */

ENTRY(0)

SECTIONS {
    .text : { *(.text*) *(.rodata*) }
    /DISCARD/ : { *(.comment) *(.note*) *(.eh_frame*) }
}

CRTC_LINE_COMPARE = 0x00000018;
INTETC45 = 0x000000EE;
NakaStr_DataFile1of2 = 0x00E000C3;
NakaStr_DataFilePck = 0x00E00113;
NakaWidget_Perf3RhythmSel_StrOff = 0x00E24046;
NakaData_TechnichordBitmap1 = 0x00E8FFD0;
NakaInst_NEXT = 0x00EDFFAF;
NakaInst_Param_EndFF = 0x00EE0027;
NakaInst_Param_Val00_01 = 0x00EDFFFF;
Naka_PresentationRootState = 0x00EEFFFD;
SeqByteBlock_EffectsSeqData = 0x00F5008B; /* v6's address: nothing in v5 places it */ /* v7's address: nothing in v6 places it */
SeqByteBlock_EffectsSeqDotExt = 0x00F500B5; /* v6's address: nothing in v5 places it */ /* v7's address: nothing in v6 places it */
SeqByteBlock_MedleyPlayback = 0x00F50085; /* v6's address: nothing in v5 places it */ /* v7's address: nothing in v6 places it */
SeqByteBlock_MedleyPlaybackB = 0x00F50093; /* v6's address: nothing in v5 places it */ /* v7's address: nothing in v6 places it */
SeqByteBlock_PathNormalize = 0x00F500D7; /* v6's address: nothing in v5 places it */ /* v7's address: nothing in v6 places it */
WidgetCharMap_DataEntry1 = 0x00EAFF8C;
WidgetName_PtrBlock_F2 = 0x00EAFF53;
WidgetName_PtrBlock_G = 0x00EAFF58;
WidgetName_PtrBlock_I1 = 0x00EAFF78;
WidgetName_PtrBlock_I2 = 0x00EAFF7A;
WidgetName_PtrBlock_K = 0x00EAFF8F;
NakaWidget_Perf3RhythmSel_StrOn = 0x00E2404E;

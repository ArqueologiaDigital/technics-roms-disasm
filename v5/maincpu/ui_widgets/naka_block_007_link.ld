/* naka_block_007_link.ld — Linker script for naka_block_007.c
 * Auto-generated by scripts/naka_struct_decode.py
  * v7 addresses where v7's own bytes agree:
 * scripts/generators/generate_v7_naka_link_scripts.py
 */

ENTRY(0)

SECTIONS {
    .text : { *(.text*) *(.rodata*) }
    /DISCARD/ : { *(.comment) *(.note*) *(.eh_frame*) }
}

AcCtlMsgGridBoxProc = 0x00F79393;
AcFadeSetGridBoxProc = 0x00F74AEE;
AcGMOnOffBoxProc = 0x00F73FD5;
AcInOutGridBoxProc = 0x00F7501F;
AcLswFuncBoxProc = 0x00F74651;
AcLswFuncEditBoxProc = 0x00F748A4;
AcMidiPartGridBoxProc = 0x00F79AAB;
AcParaLoadOptGridBoxProc = 0x00F76515;
AcPcgOutGridBoxProc = 0x00F76C91;
AcPmemOutLGridBoxProc = 0x00F77BE0;
AcPmemOutRGridBoxProc = 0x00F77F33;
AcVocalGridBoxProc = 0x00F72F07;
NakaDesc_OnOffStyle_Table = 0x00E55790; /* v6's address: nothing in v5 places it */ /* v7's address: nothing in v6 places it */
NakaDesc_PageGridBox1_Table = 0x00E5597E; /* v6's address: nothing in v5 places it */ /* v7's address: nothing in v6 places it */
NakaDesc_PmanOnOff1_Table = 0x00E557C2; /* v6's address: nothing in v5 places it */ /* v7's address: nothing in v6 places it */
NakaDesc_PmanOnOff2_Table = 0x00E55806; /* v6's address: nothing in v5 places it */ /* v7's address: nothing in v6 places it */
ClassProps_AcFadeSetGridBox = 0x00E55838;
ClassProps_AcGMOnOffBox = 0x00E557AA;
ClassProps_AcInOutGridBox = 0x00E55890;
ClassProps_AcMidiPartGridBox = 0x00E559A2;
ClassProps_AcParaLoadOptGridBox = 0x00E558BC;
ClassProps_AcPcgOutGridBox = 0x00E558E8;
ClassProps_AcPmemOutLGridBox = 0x00E55914;
ClassProps_AcPmemOutRGridBox = 0x00E55940;
ClassProps_AcVocalGridBox = 0x00E55864;
ClassName_AcFadeSetGridBox = 0x00E55C24;
ClassName_AcGMOnOffBox = 0x00E55C64;
ClassName_AcInOutGridBox = 0x00E55BFC;
ClassName_AcLswFuncBox = 0x00E55C3C;
ClassName_AcLswFuncEditBox = 0x00E55C50;
ClassName_AcParaLoadOptGridBox = 0x00E55BE2;
ClassName_AcPcgOutGridBox = 0x00E55BCE;
ClassName_AcPmemOutLGridBox = 0x00E55BB8;
ClassName_AcSendEditSw = 0x00E55C78;
ClassName_AcVocalGridBox = 0x00E55C10;
ClassPropdata_AcFadeSetGridBox = 0x00E55C20;
ClassPropdata_AcGMOnOffBox = 0x00E55C62;
ClassPropdata_AcInOutGridBox = 0x00E55BF8;
ClassPropdata_AcLswFuncBox = 0x00E55C36;
ClassPropdata_AcLswFuncEditBox = 0x00E55C4A;
ClassPropdata_AcParaLoadOptGridBox = 0x00E55BDE;
ClassPropdata_AcPcgOutGridBox = 0x00E55BCA;
ClassPropdata_AcSendEditSw = 0x00E55C72;
ClassPropdata_AcVocalGridBox = 0x00E55C0C;

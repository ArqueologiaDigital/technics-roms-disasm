/* naka_ctrl_menu_body_link.ld — Linker script for naka_ctrl_menu_body.c
 * Auto-generated by scripts/naka_struct_decode.py
 */

ENTRY(0)

SECTIONS {
    .text : { *(.text*) *(.rodata*) }
    /DISCARD/ : { *(.comment) *(.note*) *(.eh_frame*) }
}

CRTC_LINE_COMPARE = 0x00000018;
FDC_CMD_READ_ID = 0x0000000A;
NakaStr_CtrlParam9e9 = 0x00ED0027;
NakaInst_RHYTHM_SELECT_TEMPO_APC_MEMORY_SPLIT_POINT = 0x00EEFFEE;
NakaState_ZeroBlock_3 = 0x00EEFFD5;
NakaState_ZeroBlock_4 = 0x00EEFFF9;
Naka_PresentationRootState = 0x00EEFFFD;
PlySngSel2Func = 0x00F2FD59;
SeqByteBlock_EffectsSeqData = 0x00F5008B; /* v6's address: nothing in v5 places it */ /* v7's address: nothing in v6 places it */
SeqByteBlock_EffectsSeqDotExt = 0x00F500B5; /* v6's address: nothing in v5 places it */ /* v7's address: nothing in v6 places it */
SeqByteBlock_EffectsSeqEntry = 0x00F5008F; /* v6's address: nothing in v5 places it */ /* v7's address: nothing in v6 places it */
SeqByteBlock_TechnichordCfgA = 0x00F500D6; /* v6's address: nothing in v5 places it */ /* v7's address: nothing in v6 places it */
WidgetCharMap_DataEntry1 = 0x00EAFF8C;

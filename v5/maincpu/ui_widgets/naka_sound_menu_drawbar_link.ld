/* naka_sound_menu_drawbar_link.ld — Linker script for naka_sound_menu_drawbar.c
 * Auto-generated by scripts/naka_struct_decode.py
  * v7 addresses where v7's own bytes agree:
 * scripts/generators/generate_v7_naka_link_scripts.py
 */

ENTRY(0)

SECTIONS {
    .text : { *(.text*) *(.rodata*) }
    /DISCARD/ : { *(.comment) *(.note*) *(.eh_frame*) }
}

AcAccordionTabProc = 0x00F7DF8D;
AcDrawEditBoxProc = 0x00F826E7;
AcDrawSettingProc = 0x00F82258;
AcDrawbarNameProc = 0x00F82300;
AcFdemoScreenProc = 0x00F83943;
AcLswPartEditBoxProc = 0x00F7B426;
AcLswPartPanProc = 0x00F7C0C5;
AcPartMixerProc = 0x00F7FF33;
AcPleaseWaitProc = 0x00F7D6FF;
AcPresentationBoxProc = 0x00F83AAE;
AcPresentationControlProc = 0x00F83D05;
AcResetPageProc = 0x00F80065;
AcSndEMenuProc = 0x00F7AF1C;
AcTrackMixerProc = 0x00F7FF79;
AcVolPartEditBoxProc = 0x00F7B955;
AcWelcomScreenProc = 0x00F7ECD9;
IvAccordionProc = 0x00F7DB07;
IvAccordionXProc = 0x00F7DF0B;
IvDemofeature1Proc = 0x00F839E8;
IvDemofeature2Proc = 0x00F83A29;
IvDrawbar1Proc = 0x00F82B49;
IvDrawbar2Proc = 0x00F82FE2;
IvDrawbarNormProc = 0x00F831DF;
IvDrawbarProc = 0x00F81CBE;
IvDrawbarSndEProc = 0x00F8334B;
IvMPverProc = 0x00F7F01E; /* v6's address: nothing in v5 places it */ /* v7's address: nothing in v6 places it */
IvMesageProc = 0x00F7D5DA;
IvPageOverWriteProc = 0x00F825D8;
IvSdpartProc = 0x00F7AFDC;
IvSdscltyp2Proc = 0x00F7E786;
IvSdtecd1Proc = 0x00F7E158;
IvSdtecdProc = 0x00F7E092;
IvSoftverProc = 0x00F7EBDF;
Naka_PresentationRootState = 0x00EEFFFD;
PsLabelBoxProc = 0x00F7E3E4;
PsMixerControlProc = 0x00F7F254;
PsVariBoxProc = 0x00F83677;
VwUserBitmapSpProc = 0x00F838C6;
ClassProps_AcDrawSetting = 0x00E80CAA;
ClassProps_AcDrawbarName = 0x00E80CC2;
ClassProps_AcFdemoScreen = 0x00E80C92;
ClassProps_AcPleaseWait = 0x00E80C9E;
ClassProps_AcSndEMenu = 0x00E80C98;
ClassProps_IvMPver = 0x00E80CF0; /* v6's address: nothing in v5 places it */ /* v7's address: nothing in v6 places it */

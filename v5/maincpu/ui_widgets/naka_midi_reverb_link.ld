/* naka_midi_reverb_link.ld — Linker script for naka_midi_reverb.c
 * Auto-generated by scripts/naka_struct_decode.py
 */

ENTRY(0)

SECTIONS {
    .text : { *(.text*) *(.rodata*) }
    /DISCARD/ : { *(.comment) *(.note*) *(.eh_frame*) }
}

NakaInst_Param_EndFF = 0x00EE0027;
NakaInst_Param_Repeat = 0x00EDFF87;
NakaInst_Param_Val00_01 = 0x00EDFFFF;
NakaInst_Param_Val02 = 0x00EDFFC4;
NakaInst_SequencerComboBox = 0x00E90028;
Naka_PresentationRootState = 0x00EEFFFD;
PDFC = 0x00000037;
PlySngSel2Func = 0x00F2FD59;
SeqByteBlock_EffectsSeqData = 0x00F5008B; /* v6's address: nothing in v5 places it */ /* v7's address: nothing in v6 places it */
SeqByteBlock_EffectsSeqDotExt = 0x00F500B5; /* v6's address: nothing in v5 places it */ /* v7's address: nothing in v6 places it */
WidgetCharMap_DataEntry1 = 0x00EAFF8C;
WidgetCharMap_DataEntry2 = 0x00EB000B; /* v6's address: nothing in v5 places it */
NakaWidget_MdPresetUserWriteList = 0x00E57D50;
